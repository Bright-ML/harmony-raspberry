## vendor/broadcom/BCM2836/driver/mtd/spi_nor/Kconfig
```kconfig
config LOSCFG_DRIVERS_MTD_SPI_NOR
    bool "Enable MTD spi_nor flash"
    default y
    depends on LOSCFG_DRIVERS_MTD
    help
      Answer Y to support spi_nor flash.
choice
    depends on  LOSCFG_DRIVERS_MTD_SPI_NOR
    prompt "SpiNorFlash Chips"
    default LOSCFG_DRIVERS_MTD_SPI_NOR_HISFC350

config LOSCFG_DRIVERS_MTD_SPI_NOR_HISFC350
    depends on LOSCFG_PLATFORM_HI3516A || LOSCFG_PLATFORM_HI3731
    bool "Enable hisfc350"
    help
      Answer Y to support hisfc350.

config LOSCFG_DRIVERS_MTD_SPI_NOR_HIFMC100
    depends on LOSCFG_PLATFORM_HI3518EV200 || LOSCFG_PLATFORM_HI3519 || LOSCFG_PLATFORM_HI3519V101 || LOSCFG_PLATFORM_HI3559  || LOSCFG_PLATFORM_HI3516CV300 || LOSCFG_PLATFORM_HI3559AV100ES || LOSCFG_PLATFORM_HI3559AV100 || LOSCFG_PLATFORM_HI3516CV500 || LOSCFG_PLATFORM_HI3516DV300 || LOSCFG_PLATFORM_HI3516EV200 || LOSCFG_PLATFORM_HI3516EV300 || LOSCFG_PLATFORM_HI3518EV300 || LOSCFG_PLATFORM_HI3556V200 || LOSCFG_PLATFORM_HI3559V200
    bool "Enable hifmc100"
    help
      Answer Y to support hifmc100.
	  
config LOSCFG_DRIVERS_MTD_SPI_NOR_SUNXI
    depends on LOSCFG_PLATFORM_SUN8I
    bool "Enable spinor sunxi"
    help
      Answer Y to support spinor sunxi.	 
endchoice
```
